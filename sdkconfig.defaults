## sdkconfig.defaults
```kconfig
# Enable NimBLE stack
CONFIG_BT_ENABLED=y
CONFIG_BT_NIMBLE_ENABLED=y
CONFIG_BT_CONTROLLER_ENABLED=y

# Limit number of connections
CONFIG_BT_NIMBLE_MAX_CONNECTIONS=1
CONFIG_BT_CTRL_BLE_MAX_ACT=2

# Security Manager configuration
CONFIG_BT_NIMBLE_SECURITY_ENABLE=y
CONFIG_BT_NIMBLE_SM_LEGACY=y
CONFIG_BT_NIMBLE_SM_SC=y

CONFIG_BT_NIMBLE_LL_CFG_FEAT_LE_ENCRYPTION=y
CONFIG_BT_NIMBLE_SM_LVL=0
CONFIG_BT_NIMBLE_SM_SC_ONLY=0

CONFIG_BT_NIMBLE_NVS_PERSIST=y
CONFIG_BT_NIMBLE_SMP_ID_RESET=n
CONFIG_BT_NIMBLE_HANDLE_REPEAT_PAIRING_DELETION=y

# BLE Roles
CONFIG_BT_NIMBLE_ROLE_CENTRAL=n
CONFIG_BT_NIMBLE_ROLE_PERIPHERAL=y
CONFIG_BT_NIMBLE_ROLE_BROADCASTER=n
CONFIG_BT_NIMBLE_ROLE_OBSERVER=n

CONFIG_BT_NIMBLE_GATT_CLIENT=n
CONFIG_BT_NIMBLE_GATT_SERVER=y

# Phisical layer
CONFIG_BT_NIMBLE_LL_CFG_FEAT_LE_2M_PHY=y
CONFIG_BT_NIMBLE_LL_CFG_FEAT_LE_CODED_PHY=n

# Extended advertising
CONFIG_BT_NIMBLE_EXT_ADV=y
CONFIG_BT_NIMBLE_EXT_SCAN=n
CONFIG_BT_NIMBLE_ENABLE_PERIODIC_ADV=n
CONFIG_BT_NIMBLE_PERIODIC_ADV_SYNC_TRANSFER=n

# NimBLE verbosity
CONFIG_BT_NIMBLE_LOG_LEVEL_NONE=n
CONFIG_BT_NIMBLE_LOG_LEVEL_ERROR=n
CONFIG_BT_NIMBLE_LOG_LEVEL_WARNING=y
CONFIG_BT_NIMBLE_LOG_LEVEL_INFO=n
CONFIG_BT_NIMBLE_LOG_LEVEL_DEBUG=n

# NimBLE debugging
CONFIG_BT_NIMBLE_PRINT_ERR_NAME=y
CONFIG_BT_NIMBLE_DEBUG=n

# Use MbedTLS for cryptography
CONFIG_BT_NIMBLE_CRYPTO_STACK_MBEDTLS=y
CONFIG_BT_SMP_CRYPTO_STACK_MBEDTLS=y

# Use USB port for primary console
CONFIG_ESP_CONSOLE_SECONDARY_NONE=y
CONFIG_ESP_CONSOLE_USB_SERIAL_JTAG=y

# DSP config
CONFIG_DSP_OPTIMIZED=y
CONFIG_DSP_MAX_FFT_SIZE_512=y

# Partition talbe with OTA definitions
CONFIG_ESPTOOLPY_FLASHSIZE_4MB=y
CONFIG_PARTITION_TABLE_TWO_OTA=y
PARTITION_TABLE_CUSTOM_FILENAME=partitions.csv
```
